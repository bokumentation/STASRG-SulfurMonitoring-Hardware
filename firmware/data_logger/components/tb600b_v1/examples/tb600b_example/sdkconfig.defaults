## firmware/data_logger/components/tb600b_v1/examples/tb600b_example/sdkconfig.defaults
```kconfig
CONFIG_FREERTOS_HZ=1000
CONFIG_DIAG_USE_EXTERNAL_LOG_WRAP=y
CONFIG_MBEDTLS_PSK_MODES=y
CONFIG_MBEDTLS_KEY_EXCHANGE_PSK=y
CONFIG_MBEDTLS_KEY_EXCHANGE_ECDHE_PSK=y
CONFIG_MBEDTLS_KEY_EXCHANGE_RSA_PSK=y
```

## firmware/data_logger/sdkconfig.defaults
```kconfig
# FreeRTOS
CONFIG_FREERTOS_HZ=1000

# Arduino ESP32
#CONFIG_AUTOSTART_ARDUINO=y

# DIAGNOSTICS
CONFIG_DIAG_USE_EXTERNAL_LOG_WRAP=y

# mbedTLS
CONFIG_MBEDTLS_PSK_MODES=y
CONFIG_MBEDTLS_KEY_EXCHANGE_PSK=y
CONFIG_MBEDTLS_KEY_EXCHANGE_ECDHE_PSK=y
CONFIG_MBEDTLS_KEY_EXCHANGE_RSA_PSK=y
```
